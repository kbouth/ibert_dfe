## fwk/scr/yocto/meta-hdf-skel/conf/layer.conf
```bitbake
# We have a conf and classes directory, add to BBPATH
BBPATH .= ":${LAYERDIR}"

# We have recipes-* directories, add to BBFILES
BBFILES += "${LAYERDIR}/recipes-*/*/*.bb \
            ${LAYERDIR}/recipes-*/*/*.bbappend \
            ${LAYERDIR}/packagegroups/*.bb \
"

BBFILE_COLLECTIONS += "hdf"
BBFILE_PATTERN_hdf = "^${LAYERDIR}/"
BBFILE_PRIORITY_hdf = "70"

LAYERDEPENDS_hdf = "desy-util xilinx-tools"
LAYERSERIES_COMPAT_hdf = "langdale"
```
